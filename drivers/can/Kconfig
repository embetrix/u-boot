## drivers/can/Kconfig
```kconfig
menuconfig CAN
	bool "Controller Area Network support"
	depends on DM
	help
	  Driver-model support for raw Classical CAN frames. This does not
	  provide SocketCAN sockets or higher-level CAN protocols.

if CAN

config CAN_FLEXCAN
	bool "NXP i.MX95 FlexCAN"
	depends on IMX95 && CLK && PHY
	help
	  Polled Classical CAN support for i.MX95 FlexCAN controllers.
	  Supports raw data and RTR frames with standard or extended identifiers.

config CAN_SANDBOX
	bool "Sandbox CAN controller"
	depends on SANDBOX
	default y
	help
	  In-memory CAN controller for testing the CAN API and command.
	  Models internal loopback and a bus without an acknowledging peer.

endif
```
